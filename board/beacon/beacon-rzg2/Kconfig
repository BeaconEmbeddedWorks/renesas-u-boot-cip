## board/beacon/beacon-rzg2/Kconfig
```kconfig
if TARGET_BEACON_RZG2

config SYS_SOC
	default "rmobile"

config SYS_BOARD
	default "beacon-rzg2"

config SYS_VENDOR
	default "beacon"

config SYS_CONFIG_NAME
	default "beacon-rzg2"

endif
```
